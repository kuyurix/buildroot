## package/mysql_client/Config.in
```kconfig
config BR2_PACKAGE_MYSQL_CLIENT
	bool "MySQL client"
	depends on BR2_INSTALL_LIBSTDCPP
	depends on BR2_USE_MMU # fork()
	depends on BR2_TOOLCHAIN_HAS_THREADS
	select BR2_PACKAGE_NCURSES
	select BR2_PACKAGE_READLINE
	help
	  The MySQL Open Source Database System

comment "MySQL server and MySQL client needs a toolchain w/ C++, threads"
	depends on BR2_USE_MMU
	depends on !BR2_INSTALL_LIBSTDCPP || !BR2_TOOLCHAIN_HAS_THREADS

if BR2_PACKAGE_MYSQL_CLIENT
	
config BR2_PACKAGE_MYSQL_CLIENT_SERVER
	bool "MySQL server"

endif
```
